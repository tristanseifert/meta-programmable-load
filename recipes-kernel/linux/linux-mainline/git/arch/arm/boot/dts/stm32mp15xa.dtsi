// SPDX-License-Identifier: (GPL-2.0+ OR BSD-3-Clause)
/*
 * Copyright (C) STMicroelectronics 2019 - All Rights Reserved
 * Author: Alexandre Torgue <alexandre.torgue@st.com> for STMicroelectronics.
 */

/* we don't dynamically scale CPU frequency */
/*
&cpu0_opp_table {
    opp-650000000 {
        opp-hz = /bits/ 64 <650000000>;
        opp-microvolt = <1200000>;
        opp-supported-hw = <0x1>;
    };
};
*/

/ {
    // define HSEM (not in 5.15 upstream)
    hsem: hwspinlock@4c000000 {
        compatible = "st,stm32-hwspinlock";
        #hwlock-cells = <2>;
        reg = <0x4c000000 0x400>;
        clocks = <&rcc HSEM>;
        clock-names = "hsem";
    };
};
