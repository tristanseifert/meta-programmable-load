## conf/distro/sativa.conf
```bitbake
# Distribution for programmable load
DISTRO = "sativa"
DISTRO_NAME = "Sativa"
DISTRO_VERSION = "0.9"
DISTRO_CODENAME = "blunt"

SDK_VENDOR = "-sativasdk"
SDK_VERSION = "${@d.getVar('DISTRO_VERSION').replace('snapshot-${METADATA_REVISION}', 'snapshot')}"
SDK_VERSION[vardepvalue] = "${SDK_VERSION}"

MAINTAINER = "TBD <nobody@example.com>"

TARGET_VENDOR = "-sativa"

LOCALCONF_VERSION = "2"

DISTRO_FEATURES ?= "${DISTRO_FEATURES_DEFAULT}"

# Use systemd as init system
VIRTUAL-RUNTIME_init_manager = "systemd"
DISTRO_FEATURES_BACKFILL_CONSIDERED = "sysvinit"
VIRTUAL-RUNTIME_initscripts = ""

DISTRO_FEATURES:append = " systemd"
INIT_MANAGER = "systemd"

# use the systemd hardware watchdog kicking
IMAGE_INSTALL:append = " pl-systemd-watchdog"

# add some tools
# f2fs-tools: Support fsck, formatting f2fs partitions (used for user data)
# gptfdisk: Disk partitioning
# util-linux: Force re-reading partition tables
IMAGE_INSTALL:append = " dbus f2fs-tools gptfdisk util-linux "

# add some libraries most everything will depend on
IMAGE_INSTALL:append = " bzip2 libevent libevdev sqlite3"
# hardware IO libraries
IMAGE_INSTALL:append = " libgpiod libusbgx "
# hardware IO tools
IMAGE_INSTALL:append = " libgpiod-tools i2c-tools mmc-utils beep "

# support for framebuffers
# libdrm: Accessing the DRM video drivers' API
# fbset + fbset-modes: utility to change video modes (plus mode database)
IMAGE_INSTALL:append = " libdrm libdrm-kms fbset fbset-modes"

# bonus development tools
IMAGE_INSTALL:append = " systemd-analyze"

# fonts for GUI
# TODO: pare down which ones we'll actually use
# gentium: serif-y
# liberation: font family (sans, sans narrow, serif, mono)
# inconsolata: monospaced font
# dinish: DIN-style font
IMAGE_INSTALL:append = " \
    ttf-gentium \
    ttf-liberation-sans ttf-liberation-sans-narrow ttf-liberation-serif ttf-liberation-mono \
    ttf-inconsolata \
    ttf-dinish \
"

# UI libraries
# cairo: generic graphics library
# freetype: TTF rendering
# harfbuzz: Text shaping engine
# pango: Text rendering engine
# libjpeg-turbo: JPEG decoder
# libpng: PNG decoder
IMAGE_INSTALL:append = " \
    cairo freetype harfbuzz pango \
    libjpeg-turbo libpng \
"

# remove a bunch of unneeded stuff/features
DISTRO_FEATURES:remove = " \
    wayland \
    irda \
    ppp \
    pcmcia \
    smbfs \
    pci \
    3g \
    nfc \
    efi \
    ntfs \
    wifi \
    bluetooth \
    opengl \
    vulkan \
    cramfs \
    alsa \
    x11 \
    polkit \
"

# include SSH server
EXTRA_IMAGE_FEATURES += " ssh-server-dropbear"

# Use the 5.15.x series kernel
PREFERRED_VERSION_linux-yocto ?= "5.15%"
PREFERRED_VERSION_linux-yocto-rt ?= "5.15%"

# paths
SDK_NAME = "${DISTRO}-${TCLIBC}-${SDKMACHINE}-${IMAGE_BASENAME}-${TUNE_PKGARCH}-${MACHINE}"
SDKPATHINSTALL = "/opt/${DISTRO}/${SDK_VERSION}"

# suggested bonus packages
DISTRO_EXTRA_RDEPENDS += " packagegroup-core-boot"
DISTRO_EXTRA_RRECOMMENDS += " kernel-module-af-packet"

TCLIBCAPPEND = ""

# use .rpm packages by default
PACKAGE_CLASSES ?= "package_rpm"

require conf/distro/include/no-static-libs.inc
require conf/distro/include/yocto-uninative.inc
require conf/distro/include/security_flags.inc
INHERIT += "uninative"

BB_SIGNATURE_HANDLER ?= "OEEquivHash"
BB_HASHSERVE ??= "auto"
```

## conf/layer.conf
```bitbake
# We have a conf and classes directory, add to BBPATH
BBPATH .= ":${LAYERDIR}"

# We have recipes-* directories, add to BBFILES
BBFILES += "${LAYERDIR}/recipes-*/*/*.bb \
            ${LAYERDIR}/recipes-*/*/*.bbappend \
            ${LAYERDIR}/images/*.bb\
"

BBFILE_COLLECTIONS += "programmableload-base"
BBFILE_PATTERN_programmableload-base = "^${LAYERDIR}/"
BBFILE_PRIORITY_programmableload-base = "5"

LAYERVERSION_programmableload-base = "1"
LAYERSERIES_COMPAT_programmableload-base = "kirkstone"

# remove some features
DISTRO_FEATURES:remove = "wifi bluetooth nfc"
```

## conf/machine/include/stm32mp1.inc
```bitbake
# SoC tune
require conf/machine/include/soc-family.inc
SOC_FAMILY = "stm32mp1"

# CPU type
DEFAULTTUNE = "cortexa7thf-neon-vfpv4"
require conf/machine/include/arm/armv7a/tune-cortexa7.inc

# use mainline kernel
PREFERRED_PROVIDER_virtual/kernel ??= "linux-mainline"

# configure uboot entry
UBOOT_SUFFIX = "img"
UBOOT_ENTRYPOINT = "0xC2000040"

# serial console
SERIAL_CONSOLES = "115200;ttySTM0"
SERIAL_CONSOLES_CHECK = "${SERIAL_CONSOLES}"

KERNEL_IMAGETYPE ?= "zImage"

# Do not update fstab file when using wic images
WIC_CREATE_EXTRA_ARGS ?= "--no-fstab-update"

# Image
# IMAGE_FSTYPES += "tar.bz2 wic wic.gz wic.bmap"
IMAGE_FSTYPES += "wic wic.gz wic.bmap"

WKS_FILE_DEPENDS ?= " \
    virtual/bootloader \
    erofs-utils-native \
    bmap-tools-native \
"

# Wic default support
WKS_FILE ?= "stm32mp1-sdcard.wks"

# log files get persisted to data partition
VOLATILE_LOG_DIR = "false"

# servers
IMAGE_INSTALL:append = " \
    lighttpd \
"

# tools
IMAGE_INSTALL:append = " \
    curl u-boot-env \
"

# OpenAMP (for coprocessor communication)
PREFERRED_PROVIDER_libmetal="libmetal"
IMAGE_INSTALL:append = " \
    open-amp \
"

# u-boot support
IMAGE_INSTALL:append = " libubootenv libubootenv-bin "

# various generally useful libraries
IMAGE_INSTALL:append = " \
    libsocketcan \
"

# UI libraries
# boot-splash: Custom bootup splash screen
# qrencode: rendering of qr codes
IMAGE_INSTALL:append = " \
    boot-splash \
    qrencode \
"

##### custom programmable load stuff
# root fs overlays (for app data)
IMAGE_INSTALL:append = " pl-root-overlays pl-app-meta"
# general programmable load firmware stuff
IMAGE_INSTALL:append = " pl-confd pl-loadd"
# real-time control firmware

# user interface and remote
IMAGE_INSTALL:append = " pl-pinballd pl-gui"
```

## conf/machine/load-rev3.conf
```bitbake
#@TYPE: Machine
#@NAME: Programmable Load Controller
#@DESCRIPTION: Machine definition for the Rev 3 programmable load controller

require conf/machine/include/stm32mp1.inc

# build an eMMC image (no SD card slot on this board)
WKS_FILE = "programmable-load-emmc.wks"


# Kernel device tree (our custom kernel recipe installs this)
KERNEL_DEVICETREE = "stm32mp151a-programmable-load-myir-mx.dtb"

# U-Boot board/device tree config
SPL_BINARY = "u-boot-spl.stm32"
UBOOT_MAKE_TARGET = "DEVICE_TREE=stm32mp151a-programmable-load-myir-mx all"
UBOOT_MACHINE = "stm32mp15_basic_defconfig"

# U-Boot extlinux configuration
UBOOT_EXTLINUX = "1"
UBOOT_EXTLINUX_FDT = "/boot/stm32mp151a-programmable-load-myir-mx.dtb"

# boot from eMMC
# NOTE: rootedlay/rootwait are required for slow eMMC devices.
UBOOT_EXTLINUX_ROOT = "root=/dev/mmcblk0p3 rootfstype=erofs rootwait"
UBOOT_EXTLINUX_CONSOLE = ""
# ensure we use our custom overlay mounter as init
UBOOT_EXTLINUX_KERNEL_ARGS = "init=/usr/sbin/init-overlays"

# enable USB gadget support
MACHINE_FEATURES = "usbhost usbgadget"
# required images
MACHINE_ESSENTIAL_EXTRA_RDEPENDS += " \
    kernel-image \
    kernel-devicetree \
    kernel-modules \
    u-boot \
"

# test utility for display controller
IMAGE_INSTALL:append = " spidev-test "
```

## conf/machine/stm32mp157a-dk1.conf
```bitbake
#@TYPE: Machine
#@NAME: stm32mp157a-dk1 machine
#@DESCRIPTION: Reference machine configuration for https://www.st.com/en/evaluation-tools/stm32mp157a-dk1.html
#@MAINTAINER: Pierre-Jean Texier <pjtexier@koncepto.io>
#@MAINTAINER: Joris Offouga <offougajoris@gmail.com>

require conf/machine/include/stm32mp1.inc

# Kernel
KERNEL_DEVICETREE ?= "stm32mp157a-dk1.dtb"

# U-Boot
SPL_BINARY = "u-boot-spl.stm32"
UBOOT_MAKE_TARGET = "DEVICE_TREE=stm32mp157a-dk1 all"
UBOOT_MACHINE = "stm32mp15_basic_defconfig"
UBOOT_EXTLINUX = "1"
UBOOT_EXTLINUX_FDT = "/boot/stm32mp157a-dk1.dtb"
UBOOT_EXTLINUX_ROOT = "root=/dev/mmcblk0p4"
UBOOT_EXTLINUX_CONSOLE = ""
# ensure we use our custom overlay mounter as init
UBOOT_EXTLINUX_KERNEL_ARGS = "init=/usr/sbin/init-overlays"

MACHINE_FEATURES = "usbhost usbgadget"

MACHINE_ESSENTIAL_EXTRA_RDEPENDS += " \
    kernel-image \
    kernel-devicetree \
    kernel-modules \
    u-boot \
"
```

## wic/programmable-load-emmc.wks
```
# short-description: Create eMMC image for programmable load
# long-description: Creates a partitioned eMMC image for programmable load, to be flashed into
# the eMMC on the board.

### bootloader partitions
part ssbl --source rawcopy --sourceparams="file=u-boot.img" --ondisk mmcblk --align 1 --size 2M --part-name ssbl

### system data partitions
part / --source rootfs --ondisk mmcblk --fstype=erofs --mkfs-extraopts="-zlz4hc" --align 128 --size 256M --active --part-name rootfs

### user data partitions
# reserve space for an F2FS user data partition
# part /userdata --source empty --ondisk mmcblk --align 1024 --size 4M --label userdata --part-name userdata

bootloader --ptable gpt
```

## wic/stm32mp1-emmc.wks
```
# short-description: Create eMMC image for stm32mp1
# long-description: Creates a partitioned eMMC image for stm32mp1.

# TODO: update with EROFS (for rootfs, app fs) and data fs (F2FS)

part fsbl1 --source rawcopy --sourceparams="file=u-boot-spl.stm32" --ondisk mmcblk --align 1 --size 256k --part-name fsbl1
part fsbl2 --source rawcopy --sourceparams="file=u-boot-spl.stm32" --ondisk mmcblk --align 1 --size 256k --part-name fsbl2
part ssbl --source rawcopy --sourceparams="file=u-boot.img" --ondisk mmcblk --align 1 --size 2M --part-name ssbl

part / --source rootfs --ondisk mmcblk --fstype=erofs --label root --align 1 --size 768M --active
part /app --ondisk mmcblk --fstype=erofs --label=app --align 1 --size 128M

# part /userdata --use-uuid --fstype=f2fs --label=user --align 1 --size 2G

bootloader --ptable gpt
```

## wic/stm32mp1-sdcard.wks
```
# short-description: Create SD card image for stm32mp1
# long-description: Creates a partitioned SD card image for stm32mp1.

part fsbl1 --source rawcopy --sourceparams="file=u-boot-spl.stm32" --ondisk mmcblk --align 1 --size 256k --part-name fsbl1
part fsbl2 --source rawcopy --sourceparams="file=u-boot-spl.stm32" --ondisk mmcblk --align 1 --size 256k --part-name fsbl2
part ssbl --source rawcopy --sourceparams="file=u-boot.img" --ondisk mmcblk --align 1 --size 2M --part-name ssbl

part / --source rootfs --ondisk mmcblk --fstype=erofs --mkfs-extraopts="-zlz4hc" --align 128 --size 768M --active --part-name rootfs
#part /app --ondisk mmcblk --fstype=erofs --mkfs-extraopts="-zlz4hc" --align 4 --size 128M --part-name appfs

# reserve space for an F2FS user data partition
# part /userdata --source empty --ondisk mmcblk --align 1024 --size 4M --label userdata --part-name userdata

bootloader --ptable gpt
```
